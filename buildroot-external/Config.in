## buildroot-external/configs/nexora_x86_64_defconfig
```kconfig
BR2_x86_64=y
BR2_TOOLCHAIN_EXTERNAL=y
BR2_TOOLCHAIN_EXTERNAL_BOOTLIN_X86_64_GLIBC_STABLE=y
BR2_GLOBAL_PATCH_DIR="$(BR2_EXTERNAL_NEXORA_PATH)/board/nexora-x86_64/patches"
BR2_DOWNLOAD_FORCE_CHECK_HASHES=y
BR2_TARGET_GENERIC_HOSTNAME="nexora"
BR2_TARGET_GENERIC_ISSUE="Nexora OS 0.2.0 (development image)"
BR2_ROOTFS_DEVICE_CREATION_DYNAMIC_EUDEV=y
BR2_TARGET_GENERIC_GETTY_PORT="ttyS0"
BR2_TARGET_GENERIC_GETTY_BAUDRATE_115200=y
BR2_ROOTFS_USERS_TABLES="$(BR2_EXTERNAL_NEXORA_PATH)/board/nexora-x86_64/users.table"
BR2_ROOTFS_OVERLAY="$(BR2_EXTERNAL_NEXORA_PATH)/board/nexora-x86_64/rootfs-overlay"
BR2_ROOTFS_POST_BUILD_SCRIPT="$(BR2_EXTERNAL_NEXORA_PATH)/board/nexora-x86_64/post-build.sh"
BR2_ROOTFS_POST_IMAGE_SCRIPT="$(BR2_EXTERNAL_NEXORA_PATH)/board/nexora-x86_64/post-image.sh"
BR2_LINUX_KERNEL=y
BR2_LINUX_KERNEL_CUSTOM_VERSION=y
BR2_LINUX_KERNEL_CUSTOM_VERSION_VALUE="6.12.91"
BR2_LINUX_KERNEL_DEFCONFIG="x86_64"
BR2_LINUX_KERNEL_CONFIG_FRAGMENT_FILES="$(BR2_EXTERNAL_NEXORA_PATH)/board/nexora-x86_64/linux.fragment"
BR2_LINUX_KERNEL_INSTALL_TARGET=y
BR2_LINUX_KERNEL_NEEDS_HOST_OPENSSL=y
BR2_LINUX_KERNEL_NEEDS_HOST_LIBELF=y
BR2_PACKAGE_ALSA_UTILS=y
BR2_PACKAGE_ALSA_UTILS_AMIXER=y
BR2_PACKAGE_ALSA_UTILS_APLAY=y
BR2_PACKAGE_E2FSPROGS=y
BR2_PACKAGE_DEJAVU=y
BR2_PACKAGE_MESA3D=y
BR2_PACKAGE_MESA3D_LLVM=y
BR2_PACKAGE_MESA3D_GALLIUM_DRIVER_CROCUS=y
BR2_PACKAGE_MESA3D_GALLIUM_DRIVER_IRIS=y
BR2_PACKAGE_MESA3D_GALLIUM_DRIVER_LLVMPIPE=y
BR2_PACKAGE_MESA3D_GALLIUM_DRIVER_RADEONSI=y
BR2_PACKAGE_MESA3D_GALLIUM_DRIVER_VIRGL=y
BR2_PACKAGE_MESA3D_OPENGL_ES=y
BR2_PACKAGE_QT6=y
BR2_PACKAGE_QT6BASE_EGLFS=y
BR2_PACKAGE_QT6BASE_DEFAULT_QPA="eglfs"
BR2_PACKAGE_QT6BASE_FONTCONFIG=y
BR2_PACKAGE_QT6BASE_HARFBUZZ=y
BR2_PACKAGE_QT6BASE_PNG=y
BR2_PACKAGE_LINUX_FIRMWARE=y
BR2_PACKAGE_LINUX_FIRMWARE_AMDGPU=y
BR2_PACKAGE_LINUX_FIRMWARE_I915=y
BR2_PACKAGE_LINUX_FIRMWARE_XE=y
BR2_TARGET_ROOTFS_EXT2=y
BR2_TARGET_ROOTFS_EXT2_4=y
BR2_TARGET_ROOTFS_EXT2_LABEL="nexora-root"
BR2_TARGET_ROOTFS_EXT2_SIZE="2048M"
# BR2_TARGET_ROOTFS_TAR is not set
BR2_TARGET_GRUB2=y
BR2_TARGET_GRUB2_X86_64_EFI=y
BR2_TARGET_GRUB2_BUILTIN_MODULES_EFI="boot linux ext2 fat part_gpt part_msdos normal efi_gop search search_label search_fs_uuid echo test loadenv configfile regexp"
BR2_TARGET_GRUB2_INSTALL_TOOLS=y
BR2_PACKAGE_HOST_DOSFSTOOLS=y
BR2_PACKAGE_HOST_GENIMAGE=y
BR2_PACKAGE_HOST_MTOOLS=y
BR2_PACKAGE_NEXORA_OS=y
```

## buildroot-external/package/nexora-os/Config.in
```kconfig
config BR2_PACKAGE_NEXORA_OS
	bool "nexora-os"
	depends on BR2_PACKAGE_QT6
	depends on BR2_TOOLCHAIN_GCC_AT_LEAST_10 # C++20
	select BR2_PACKAGE_QT6BASE_GUI
	select BR2_PACKAGE_QT6BASE_NETWORK # QLocalServer/QUdpSocket for save-state adapters
	select BR2_PACKAGE_QT6BASE_SQL
	select BR2_PACKAGE_QT6BASE_SQLITE
	select BR2_PACKAGE_QT6DECLARATIVE
	select BR2_PACKAGE_QT6DECLARATIVE_QUICK
	select BR2_PACKAGE_OPENSSL # Ed25519/SHA-256 for signed updates
	help
	  Nexora OS console user interface (nexora-console-ui), a
	  controller-first Qt 6 / QML launcher for native Linux
	  emulators, built from the Nexora OS source tree that
	  contains this BR2_EXTERNAL tree.

	  Installs /usr/bin/nexora-console-ui, the update bundle
	  verifier /usr/bin/nexora-update-tool, the example emulator
	  configuration in /usr/share/nexora/emulators and the trusted
	  update public keys (*.pem) found in
	  board/nexora-x86_64/update-keys/ into
	  /usr/share/nexora/update-keys. Without a key, updates are
	  refused (fail closed).

	  The optional SDL3 gamepad backend is not available: the
	  pinned Buildroot release (2026.02.x LTS) has no sdl3
	  package, so the evdev backend is used.

	  https://github.com/szebasztianmarton/Nexora-OS

comment "nexora-os needs Qt6 and a toolchain w/ gcc >= 10"
	depends on !BR2_PACKAGE_QT6 || !BR2_TOOLCHAIN_GCC_AT_LEAST_10
```
